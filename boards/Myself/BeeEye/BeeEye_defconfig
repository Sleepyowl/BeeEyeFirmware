## boards/Myself/BeeEye/BeeEye_defconfig
```kconfig
CONFIG_ARM_MPU=y
CONFIG_HW_STACK_PROTECTION=y

# We've got no 32kHz crystal
CONFIG_CLOCK_CONTROL_NRF_K32SRC_RC=y
CONFIG_CLOCK_CONTROL_NRF_K32SRC_XTAL=n
```

## boards/Myself/BeeEye/dts/bindings/custom/vsense.yaml
```yaml
# SPDX-License-Identifier: Apache-2.0
description: Custom voltage sense peripheral

compatible: "custom,vsense"

properties:
  label:
    type: string
    required: false
    description: Human-readable device label
    
  enable-gpios:
    type: phandle-array
    required: true
    description: GPIO to enable voltage divider

  io-channels:
    type: phandle-array
    required: true
    description: ADC channel used for voltage sense
```
